## drivers/misc/mediatek/pmic/Kconfig
```kconfig
#
# MTK PMIC configuration
#

config MTK_PMIC_NEW_ARCH
	tristate "MediaTek Power Management New Arch driver"
	default n
	---help---
	  This selects for MediaTek(R) PMIC New Arch driver.
	  Separate pmic feature form Power folder that also have battery and charging feature.
	  Select y to support MTK PMIC NEW ARCH.
	  If so, you should choose the corresponding main chip to follow.

	  Select n to support MTK PMIC LEGACY ARCH.

config MTK_PMIC_COMMON
	tristate "MediaTek Power Management Common driver"
	default n
	---help---
	  This selects for MediaTek(R) PMIC common driver.
	  This feature is mainly to separate to common and platform part from driver layer.
	  Select y to support MTK PMIC COMMON feature.
	  Set n and choose other chip.

config MTK_PMIC_CHIP_MT6353
	tristate "MediaTek PMIC MT6353 Driver"
	default n
	---help---
	  This selects for MediaTek(R) PMIC MT6353 driver.
	  It's main chip type and providing power features like auxadc,
	  buck/ldo, interrupt-controller..etc
	  Set y to support this driver.
	  Set n and choose other chip.

config MTK_PMIC_CHIP_MT6355
	tristate "MediaTek PMIC MT6355 Driver"
	default n
	---help---
	  This selects for MediaTek(R) PMIC MT6355 driver.
	  It's main chip type and providing power features like auxadc,
	  buck/ldo, interrupt-controller..etc
	  Set y to support this driver.
	  Set n and choose other chip.

config MTK_PMIC_CHIP_MT6351
	tristate "MediaTek PMIC MT6351 Driver"
	default n
	---help---
	  This selects for MediaTek(R) PMIC MT6351 driver.
	  It's the main PMIC of the Helio P10 (MT6755) family as used on the
	  Meizu M3 Note (m681); provides auxadc, buck/ldo and the
	  interrupt-controller.  Register map + init sequence are ported from
	  the confirmed-bootable 3.10 stock tree.
	  Set y to support this driver.
	  Set n and choose other chip.

config MTK_SPM_PMIC_MT6351
	bool "SPM uses the MT6351 power tables under the MT6353-named driver"
	depends on MTK_PMIC_CHIP_MT6353 && MACH_MT6755
	default n
	---help---
	  The m681/l681 4.4 kernels run MT6351 hardware through the
	  MT6353-named PMIC driver (MTK_PMIC_CHIP_MT6353=y).  spm_v2 keyed
	  its firmware names (pcm_*_m.bin / _r.bin) and its PMIC-wrap command
	  table (VCORE/VSRAM/VPROC addresses) on the same symbol, i.e. it
	  asked for MT6750/MT6353 SPM firmware and would program MT6353
	  register addresses into an MT6351.  Say y on MT6351 boards to give
	  spm_v2 its MT6351 branch (plain pcm_*.bin names, MT6351_* tables)
	  while the PMIC driver itself stays MT6353-named.

config MTK_PMIC_CHIP_MT6335
	tristate "MediaTek Power MT6335 Driver"
	default n
	---help---
	  This selects for MediaTek(R) PMIC MT6335 driver.
	  It's main chip type and providing power features like auxadc,
	  buck/ldo, interrupt-controller..etc
	  Set y to support this driver.
	  Set n and choose other chip.

config MTK_PMIC_CHIP_MT6337
	tristate "MediaTek Power MT6337 Driver"
	default n
	---help---
	  This selects for MediaTek(R) PMIC MT6337 driver.
	  It's sub chip type and used mainly in audio controlling.
	  Set y to support this driver.
	  Set n and choose other chip.

config MTK_PMIC_CHIP_MT6336
	tristate "MediaTek Power MT6336 Driver"
	default n
	---help---
	  This selects for MediaTek(R) PMIC MT6336 driver.
	  This driver uses I2C bus.
	  Set y to support this driver.
	  Set n and choose other chip.

config MTK_PMIC_CHIP_MT6313
	tristate "MediaTek Power MT6313 Driver"
	default n
	---help---
	  This selects for MediaTek(R) PMIC MT6313 driver.
	  It's sub chip type and used mainly in buck controlling.
	  Set y to support this driver.
	  Set n and choose other chip.

config MTK_EXTBUCK
	tristate "EXT BUCK Driver"
	default n
	---help---
	  This selects for EXT BUCK driver.
	  It's sub chip type and used mainly in buck controlling.
	  Set y to support this driver.
	  Set n and choose other chip.

if MTK_LDVT
config MTK_LDVT_PMIC
	bool "MediaTek PMIC driver for LDVT"
	default y
	---help---
	  MediaTek PMIC driver for LDVT
	  Set y to support DVT.
	  Set n to default.
endif

config MTK_AUXADC_INTF
	bool "MediaTek PMIC Auxadc interface"
	depends on MTK_PMIC_NEW_ARCH
	default n
	---help---
	  MediaTek PMIC Auxadc interface Driver
	  only for MTK_PMIC_NEW_ARCH
	  Set y to enable it.
	  Set n to disable it.

config REGULATOR_ISL91302A
	bool "Intersil Spi Ext Buck Isl91302a"
	depends on MTK_EXTBUCK
	default n
	---help---
	  Intersil SPI Interface
	  External Buck for
	  GPU, PROC1, PROC2
	  Regulator Driver

source "drivers/misc/mediatek/pmic/rt5081/Kconfig"
```

## drivers/misc/mediatek/vibrator/mt6755/Kconfig
```kconfig
config MTK_M681_VIBRATOR
	tristate "M681 MT6351 vibrator with checked power control"
	depends on OF && LEDS_CLASS && !MTK_VIBRATOR
	default n
	help
	  Expose the legacy vibrator LED attributes with checked MT6351 writes.
	  Requires the PMIC backend to return errors for denied writes.
	  Does not grant access through the PMIC write gate.
```

## drivers/watchdog/mediatek/wdt/Kconfig
```kconfig
config MTK_WATCHDOG
	tristate "Enable MTK watchDog"
	default y
	help
	  MTK watchdog driver enable/disable in the kernel.

	  Say Y here if you want to use Mediatek watchdog driver.

	  Please note that Mediatek watchdog driver doesn't use
	  watchdog core defined by WATCHDOG_CORE.

config MTK_WATCHDOG_COMMON
	bool "Use MTK watchdog common driver"
	help
	  Use Mediatek watchdog common driver. Common driver
	  version may be different on different platforms and shall
	  be seleted by proper kernel option.

	  Say Y here if you want to use Mediatek watchdog common driver.
	  Please note that driver version shall be properly selected in
	  below menu as well.

choice
	prompt "MTK watchdog common driver version"
	depends on MTK_WATCHDOG_COMMON
	help
	  Select Mediatek watchdog common driver version.

	config MTK_WATCHDOG_COMMON_V1
		bool "Use MTK watchdog common driver v1"

	config MTK_WATCHDOG_COMMON_V2
		bool "Use MTK watchdog common driver v2"
endchoice

config MTK_WD_KICKER
	tristate "Enable MTK watchdog kicker"
	default y
	help
	  Medaitek watchdog kicker is a kernel module to detect possible hang
	  issue.

	  Say Y here if you want to enable Mediatek watchdog kicker.

config MTK_WDT_DIAG_HARD
	bool "m5c bring-up: hard watchdog deadman (never kick, plain reset mode)"
	default n
	help
	  Diagnostic-only mode for the m5c 4.9 bring-up: the probe arms the
	  hardware WDT in plain reset mode (no dual/IRQ stage, same as LK's
	  arming) and mtk_wdt_restart() becomes a no-op, so NOTHING ever
	  kicks. Any hang - including an 'alive but stuck' state that still
	  runs kthreads - ends in a warm reset within the timeout, which
	  preserves DRAM (log window + markers). Without this, a boot
	  that reaches the WDT driver and then wedges forces a long-press
	  power-off, which cold-resets the PMIC and wipes all evidence
	  (m5c P12 finding). Never enable in a production image: a healthy
	  boot also resets ~30 s after power-on.
```
