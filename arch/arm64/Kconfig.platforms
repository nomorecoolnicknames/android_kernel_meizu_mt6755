## arch/arm64/Kconfig.platforms
```kconfig
menu "Platform selection"

config ARCH_BCM_IPROC
	bool "Broadcom iProc SoC Family"
	help
	  This enables support for Broadcom iProc based SoCs

config ARCH_BERLIN
	bool "Marvell Berlin SoC Family"
	select ARCH_REQUIRE_GPIOLIB
	select DW_APB_ICTL
	help
	  This enables support for Marvell Berlin SoC Family

config ARCH_EXYNOS
	bool
	help
	  This enables support for Samsung Exynos SoC family

config ARCH_EXYNOS7
	bool "ARMv8 based Samsung Exynos7"
	select ARCH_EXYNOS
	select COMMON_CLK_SAMSUNG
	select HAVE_S3C2410_WATCHDOG if WATCHDOG
	select HAVE_S3C_RTC if RTC_CLASS
	select PINCTRL
	select PINCTRL_EXYNOS

	help
	  This enables support for Samsung Exynos7 SoC family

config ARCH_LAYERSCAPE
	bool "ARMv8 based Freescale Layerscape SoC family"
	help
	  This enables support for the Freescale Layerscape SoC family.

config ARCH_HISI
	bool "Hisilicon SoC Family"
	help
	  This enables support for Hisilicon ARMv8 SoC family

config ARCH_MEDIATEK
	bool "Mediatek MT65xx & MT81xx ARMv8 SoC"
	select ARM_GIC
	select PINCTRL
	help
	  Support for Mediatek MT65xx & MT81xx ARMv8 SoCs

# m681/mt6755: the platform code forward-ported from the 3.18 m6-graft is gated on
# CONFIG_ARCH_MT6755 (the 3.18 symbol). The 4.4 tree uses CONFIG_MACH_MT675x, so
# define ARCH_MT6755 to track MACH_MT6755 — this activates the graft's mt6755
# clk/SPM/idle/MTCMOS code paths uniformly instead of per-file #ifdef patching.
config ARCH_MT6755
	bool
	default y if MACH_MT6755

config MACH_MT6757
	bool "MediaTek MT6757"
	select GENERIC_TIME
	select GENERIC_CLOCKEVENTS
	select ARCH_HAS_CPUFREQ
	select ARM_AMBA
	select CPU_V7
	select HAVE_SMP
	select NEED_MACH_MEMORY_H
	select IRQ_DOMAIN
	select IRQ_DOMAIN_DEBUG
	select GENERIC_SCHED_CLOCK
	select MTK_SYS_CIRQ
	select ARMV7_COMPAT
	select ARMV7_COMPAT_CPUINFO
	select CPU_IDLE
	select PINCTRL
	select PINCTRL_MT6757
	select MFD_SYSCON
	select MTK_BASE_POWER
	select MTK_SYSTRACKER_V2
	select MTK_GIC_V3_EXT
	select MTK_CPU_STRESS
	select MTK_LM_MODE if !MTK_GMO_RAM_OPTIMIZE
	select MTK_EIC_HISTORY_DUMP
	select MTK_EIC
	select MTK_L2C_PARITY_CHECK
	select MTK_LASTPC_V2
	# select MTK_USB2JTAG_SUPPORT
	select MTK_IRQ_NEW_DESIGN
	select MTK_IRQ_NEW_DESIGN_DEBUG
	select MTK_WATCHPOINT
	select MTK_SEC_DEINT_SUPPORT
	select MTK_CQDMA
	select MTK_BOUNCING_CHECK
	help
	  This enables support for MediaTek Helio P20 - MT6757
	  Highly power-efficient, performance-oriented 4G LTE processor for premium,
	  thin-design smartphones. The MediaTek Helio P20 is built on a 16nm process
	  node and offers 25% better power efficiency, higher processing performance
	  and our most advanced camera/video features to date. Helio P20 also offers
	  significant multitasking and multimedia improvements thanks to its new
	  LPDDR4X memory support.

config MACH_MT6755
	bool "MediaTek MT6755"
	select GENERIC_TIME
	select GENERIC_CLOCKEVENTS
	select ARCH_HAS_CPUFREQ
	select ARM_AMBA
	select CPU_V7
	select HAVE_SMP
	select NEED_MACH_MEMORY_H
	select IRQ_DOMAIN
	select IRQ_DOMAIN_DEBUG
	select GENERIC_SCHED_CLOCK
	select MTK_SYS_CIRQ
	select ARMV7_COMPAT
	select ARMV7_COMPAT_CPUINFO
	select CPU_IDLE
	select PINCTRL
	select PINCTRL_MT6755
	select MFD_SYSCON
	select MTK_BASE_POWER
	# m681: systracker (bus-transaction tracker) is debug-only and needs a
	# systracker/mt6755 dir; deferred for the boot milestone.
	select MTK_SYSTRACKER_V2
	# m681 (MT6755/Helio P10) is GIC-400 / GICv2, NOT GICv3.
	# Carried MTK GICv2 driver: drivers/irqchip/irq-mt-gic.c (config MTK_GIC).
	# Do NOT select MTK_GIC_V3_EXT / ARM_GIC_V3 here.
	select MTK_GIC
	select MTK_CPU_STRESS
	select MTK_LM_MODE if !MTK_GMO_RAM_OPTIMIZE
	select MTK_EIC_HISTORY_DUMP
	select MTK_EIC
	# m681: L2C parity check is a debug/RAS feature (default n); its l2c-parity.c
	# needs a per-platform plat-cfg.h that only ships for mt6757. Don't select it
	# for the boot milestone (graft 3.18 didn't build it for mt6755 either).
	# select MTK_L2C_PARITY_CHECK
	select MTK_LASTPC_V2
	# m681: USB2JTAG (debug bridge) needs a usb2jtag/mt6755 dir; defer for boot.
	select MTK_USB2JTAG_SUPPORT
	select MTK_WATCHPOINT
	select MTK_SEC_DEINT_SUPPORT
	select MTK_CQDMA
	select MTK_BOUNCING_CHECK
	help
	  This enables support for MediaTek Helio P10 - MT6755
	  (m681 / Meizu M3 Note). 64-bit octa-core Cortex-A53 LTE SoC built
	  on a 28nm process. Forward-ported from the working Linux 3.18 m681
	  vendor kernel (which used CONFIG_ARCH_MT6755) into this 4.4 tree
	  using the 4.4 CONFIG_MACH_MT675x convention. NOTE: MT6755 uses a
	  GICv2 (GIC-400) interrupt controller, unlike the MT6757 donor's
	  GICv3 (MTK_GIC_V3_EXT) - see the GICv2 TODO above.

config MACH_KIBOPLUS
	bool "MediaTek KIBOPLUS"
	select GENERIC_TIME
	select GENERIC_CLOCKEVENTS
	select ARCH_HAS_CPUFREQ
	select ARM_AMBA
	select CPU_V7
	select HAVE_SMP
	select NEED_MACH_MEMORY_H
	select IRQ_DOMAIN
	select IRQ_DOMAIN_DEBUG
	select GENERIC_SCHED_CLOCK
	select MTK_SYS_CIRQ
	select ARMV7_COMPAT
	select ARMV7_COMPAT_CPUINFO
	select CPU_IDLE
	select PINCTRL
	select PINCTRL_MT6757
	select MFD_SYSCON
	select MTK_BASE_POWER
	select MTK_SYSTRACKER_V2
	select MTK_GIC_V3_EXT
	select MTK_CPU_STRESS
	select MTK_LM_MODE if !MTK_GMO_RAM_OPTIMIZE
	select MTK_EIC_HISTORY_DUMP
	select MTK_TIMER
	select MTK_EIC
	select MTK_LASTPC_V2
	select MTK_IRQ_NEW_DESIGN
	select MTK_IRQ_NEW_DESIGN_DEBUG
	select MTK_WATCHPOINT
	select MTK_BOUNCING_CHECK
	help
	  This enables support for KIBOPLUS
	  Support for aarch64 Architecture
	  Support for evb_kp_64 related projects
	  Support for phone_kp_64 related projects

config MACH_MT6799
	bool "MediaTek MT6799"
	select GENERIC_TIME
	select GENERIC_CLOCKEVENTS
	select ARCH_HAS_CPUFREQ
	select ARM_AMBA
	select CPU_V7
	select HAVE_SMP
	select NEED_MACH_MEMORY_H
	select IRQ_DOMAIN
	select IRQ_DOMAIN_DEBUG
	select GENERIC_SCHED_CLOCK
	select MTK_SYS_CIRQ
	select ARMV7_COMPAT
	select ARMV7_COMPAT_CPUINFO
	select CPU_IDLE
	select PINCTRL
	select PINCTRL_MT6799
	select MFD_SYSCON
	select MTK_GIC_V3_EXT
	select MTK_CPU_STRESS
	select MTK_LM_MODE if !MTK_GMO_RAM_OPTIMIZE
	select MTK_EIC_HISTORY_DUMP
	select MTK_TIMER
	select MTK_EIC
	help
	  This enables support for MediaTek MT6799
	  Support for aarch64 Architecture
	  Support for fpga6799_64 related projects
	  Support for evb6799_64 related projects

config MACH_MT8167
	bool "MediaTek MT8167"
	select GENERIC_TIME
	select GENERIC_CLOCKEVENTS
	select ARCH_HAS_CPUFREQ
	select ARM_AMBA
	select CPU_V7
	select HAVE_SMP
	select NEED_MACH_MEMORY_H
	select IRQ_DOMAIN
	select IRQ_DOMAIN_DEBUG
	select GENERIC_SCHED_CLOCK
	select ARMV7_COMPAT
	select ARMV7_COMPAT_CPUINFO
	select CPU_IDLE
	select PINCTRL
	select PINCTRL_MT8167
	select MFD_SYSCON
	select MTK_BASE_POWER
	select MTK_TIMER
	select MTK_GIC_EXT
	help
	  This enables support for MediaTek MT8167

config ARCH_QCOM
	bool "Qualcomm Platforms"
	select PINCTRL
	help
	  This enables support for the ARMv8 based Qualcomm chipsets.

config ARCH_ROCKCHIP
	bool "Rockchip Platforms"
	select ARCH_HAS_RESET_CONTROLLER
	select ARCH_REQUIRE_GPIOLIB
	select PINCTRL
	select PINCTRL_ROCKCHIP
	help
	  This enables support for the ARMv8 based Rockchip chipsets,
	  like the RK3368.

config ARCH_SEATTLE
	bool "AMD Seattle SoC Family"
	help
	  This enables support for AMD Seattle SOC Family

config ARCH_STRATIX10
	bool "Altera's Stratix 10 SoCFPGA Family"
	help
	  This enables support for Altera's Stratix 10 SoCFPGA Family.

config ARCH_TEGRA
	bool "NVIDIA Tegra SoC Family"
	select ARCH_HAS_RESET_CONTROLLER
	select ARCH_REQUIRE_GPIOLIB
	select CLKDEV_LOOKUP
	select CLKSRC_MMIO
	select CLKSRC_OF
	select GENERIC_CLOCKEVENTS
	select HAVE_CLK
	select PINCTRL
	select RESET_CONTROLLER
	help
	  This enables support for the NVIDIA Tegra SoC family.

config ARCH_TEGRA_132_SOC
	bool "NVIDIA Tegra132 SoC"
	depends on ARCH_TEGRA
	select PINCTRL_TEGRA124
	select USB_ULPI if USB_PHY
	select USB_ULPI_VIEWPORT if USB_PHY
	help
	  Enable support for NVIDIA Tegra132 SoC, based on the Denver
	  ARMv8 CPU.  The Tegra132 SoC is similar to the Tegra124 SoC,
	  but contains an NVIDIA Denver CPU complex in place of
	  Tegra124's "4+1" Cortex-A15 CPU complex.

config ARCH_SPRD
	bool "Spreadtrum SoC platform"
	help
	  Support for Spreadtrum ARM based SoCs

config ARCH_THUNDER
	bool "Cavium Inc. Thunder SoC Family"
	help
	  This enables support for Cavium's Thunder Family of SoCs.

config ARCH_VEXPRESS
	bool "ARMv8 software model (Versatile Express)"
	select ARCH_REQUIRE_GPIOLIB
	select COMMON_CLK_VERSATILE
	select POWER_RESET_VEXPRESS
	select VEXPRESS_CONFIG
	help
	  This enables support for the ARMv8 software model (Versatile
	  Express).

config ARCH_XGENE
	bool "AppliedMicro X-Gene SOC Family"
	help
	  This enables support for AppliedMicro X-Gene SOC Family

config ARCH_ZYNQMP
	bool "Xilinx ZynqMP Family"
	help
	  This enables support for Xilinx ZynqMP Family

endmenu
```

## drivers/clk/mediatek/Kconfig
```kconfig
#
# MediaTek SoC drivers
#
config COMMON_CLK_MEDIATEK
	bool
	---help---
	  Mediatek SoCs' clock support.

config COMMON_CLK_MEDIATEK_V1
	bool
	select COMMON_CLK_MEDIATEK
	---help---
	  An older version (V1) of Mediatek clock common code support.

config COMMON_CLK_MT6757
	bool "Clock driver for Mediatek MT6757"
	depends on COMMON_CLK
	select COMMON_CLK_MEDIATEK_V1
	default y if (MACH_MT6757 || MACH_KIBOPLUS) && !MTK_CLKMGR
	---help---
	  This driver supports Mediatek MT6757 clocks.
	  Use the config to support CCF on MT6757,
	  instead of old clkmgr architecture.
	  MT6757 default will use CCF.

config COMMON_CLK_MT6755
	bool "Clock driver for Mediatek MT6755"
	depends on COMMON_CLK
	select COMMON_CLK_MEDIATEK_V1
	default y if MACH_MT6755 && !MTK_CLKMGR
	---help---
	  This driver supports Mediatek MT6755 (Helio P10) clocks.
	  Forward-ported from the working 3.18 m681 vendor kernel; uses the
	  same V1 CCF infra as MT6757. 3.18 selected via ARCH_MT6755; in this
	  4.4 tree it is keyed off MACH_MT6755 instead.
```

## drivers/input/touchscreen/mediatek/Kconfig
```kconfig
#
# Touchscreen driver configuration
#
menuconfig INPUT_TOUCHSCREEN
	bool "Touchscreens"
	help
	  Say Y here, and a list of supported touchscreens will be displayed.
	  This option doesn't affect the kernel.

	  If unsure, say Y.

if INPUT_TOUCHSCREEN

config TOUCHSCREEN_MTK
	bool "MediaTek Touch Panel Driver"
	help
	  Say Y here if you have MediaTek touch panel.

	  If unsure, say N.

	  To compile this dirver as a module, choose M here: the
	  module will be called.

config TOUCHSCREEN_MTK_GT1151
	bool "GT1151 for Mediatek package"
	default n
	help
	  Say Y here if you have GT1151 touch panel.

	  If unsure, say N.

	  To compile this dirver as a module, choose M here: the
	  module will be called.

source "drivers/input/touchscreen/mediatek/GT1151/Kconfig"

config TOUCHSCREEN_MTK_FT8716
	bool "FT8716 for Mediatek package"
	default n
	help
	  Say Y here if you have FT8716 touch panel.

	  If unsure, say N.

	  To compile this dirver as a module, choose M here: the
	  module will be called.
source "drivers/input/touchscreen/mediatek/FT8716/Kconfig"

source "drivers/input/touchscreen/mediatek/gn_nt36xxx/Kconfig"

config TOUCHSCREEN_MTK_SYNAPTICS
	tristate "synaptics_dsx"
	depends on I2C
	help
	  Say Y here if you have a synaptics_dsx
	  connected to your system.

	  If unsure, say N.

	  To compile this driver as a module, choose M here: the
	  module will be called synaptics_dsx.

source "drivers/input/touchscreen/mediatek/synaptics_dsx/Kconfig"

config TOUCHSCREEN_MTK_GT9XX_MZ
	bool "GT9XX_MZ (Meizu Goodix GT9xx) for Mediatek package"
	help
	  Stock Meizu m681 Goodix GT9xx touch driver (GT917D/GT915L), ported
	  from the m681 3.10 tree via the 3.18 graft (device-verified there,
	  v257). Binds the DTS cap_touch@5d node via "mediatek,cap_touch".

	  If unsure, say N.

endif
```

## drivers/misc/mediatek/alsps/pa12200001/Kconfig
```kconfig
config MTK_PA12200001
	bool "TXC PA12200001 ALS/PS for MediaTek package"
	default n
	help
	  TXC PA12200001 ambient light + proximity sensor (m681
	  dual-source variant, i2c1 @ 0x1E). Probes the shared
	  "mediatek,alsps" client after ltr579 NAKs; keep MTK_LTR579=y
	  for the other variant.
```

## drivers/misc/mediatek/magnetometer/st480/Kconfig
```kconfig
config MTK_ST480
	bool "Senodia ST480 magnetometer for MediaTek package"
	default n
	help
	  Senodia ST480 magnetometer (m681 dual-source variant, i2c1 @
	  0x0D). Probes the shared "mediatek,msensor" client after
	  akm09911 fails its chip check; keep MTK_AKM09911_NEW=y for the
	  other variant.
```
